# Template register map
Vendor: VendorName Co.Ltd; Series: SeriesName; File version: 1.2
CPU: CM7 r0p1, little endian, MPU, FPU, 4 interrupt priority bits
Registers are 32-bit, read-write, no defined reset value unless marked. A register's access mark holds for its fields unless they carry their own. Offsets are from the block's base; lines under a group give offsets from that group; [hi:lo] are bit positions; {n}, {i} and the like mark numbered series; 'fields as' and 'values as' point back to an identical list; <NAME> marks a mode.

## Memory map
{0x3FFFF000+0x1000*n} EPWM{n} size 0x7CC (n=1..18) — Enhanced Pulse Width Modulator {n}
0x40013000 DAC1 size 0x1C — Digital-to-Analog Convertor 1
0x40013100 DAC3 size 0x1C — Digital-to-Analog Convertor 2
0x40014000 SDFM1 size 0x158 — Sigma Delta Filter Module 1
0x40015000 SDFM2 size 0x158 — Sigma Delta Filter Module 2
0x40016000 SDFM3 size 0x158 — Sigma Delta Filter Module 3
0x40017000 SDFM4 size 0x158 — Sigma Delta Filter Module 4
{0x4001AF00+0x100*n} CMPSS{n} size 0x100 (n=1..8) — Comparer Subsystem {n}
0x4001D000 ECAP1 size 0x84 — Enhanced Capture 1
0x4001D200 ECAP2 size 0x84 — Enhanced Capture 2
0x4001D400 ECAP3 size 0x84 — Enhanced Capture 3
0x4001D600 ECAP4 size 0x84 — Enhanced Capture 4
0x4001D800 ECAP5 size 0x84 — Enhanced Capture 5
0x4001DA00 ECAP6 size 0x84 — Enhanced Capture 6
0x4001DC00 ECAP7 size 0x84 — Enhanced Capture 7
0x4001F000 EQEP1 size 0x78 — Enhanced Quadrature Encoder Pulse 1
0x4001F200 EQEP2 size 0x78 — Enhanced Quadrature Encoder Pulse 2
0x4001F400 EQEP3 size 0x78 — Enhanced Quadrature Encoder Pulse 3
0x4001F600 EQEP4 size 0x78 — Enhanced Quadrature Encoder Pulse 4
0x4001F800 EQEP5 size 0x78 — Enhanced Quadrature Encoder Pulse 5
0x4001FA00 EQEP6 size 0x78 — Enhanced Quadrature Encoder Pulse 6
0x40020000 PWR size 0xB0 — Power Control
0x40021000 IWDG2 size 0x18 — Independent Watchdog 2
0x40022000 AWK size 0x10 — Auto Wake Timer
0x40023000 LPTIM size 0x10 — Low Power Timer
0x40030000 ADCA size 0x210 — Analog-to-Digital Converter A
0x40031000 ADCB size 0x210 — Analog-to-Digital Converter B
0x40032000 ADCC size 0x210 — Analog-to-Digital Converter C
0x40033000 ADCD size 0x210 — Analog-to-Digital Converter D
0x40034000 ANASS size 0x5C — Analog Subsystem
0x40036000 XBAR size 0x778 — Crossbar
0x40037000 SYSCON size 0xA00 — System Control
0x40038000 ADCSAFETYCHKAGG1 size 0x5C — Analog-to-Digitial Safety Checker Aggregate 1
0x40038100 ADCSAFETYCHKAGG2 size 0x5C — Analog-to-Digitial Safety Checker Aggregate 2
{0x40038100+0x100*n} ADCSAFETYCHKCHK{n} size 0x1C (n=1..8) — Analog-to-Digitial Safety Checker Check {n}
0x40042000 UART1 size 0x30 — Universal Asynchronous Receiver Or Transmitter 1
0x40043000 UART2 size 0x30 — Universal Asynchronous Receiver Or Transmitter 2
0x40046000 SPI1 size 0x70 — Serial Peripheral Interface 1
0x40047000 SPI2 size 0x70 — Serial Peripheral Interface 2
0x40048000 I2C1 size 0x174 — Inter-Integrated Circuit 1
0x4004A000 TIM1 size 0x60 — Advanced-Control Timer 1
0x4004B000 TIM2 size 0x60 — Advanced-Control Timer 2
0x40059000 DCC1 size 0x24 — Dual-Clock Comparator
0x40060000 UART3 size 0x30 — Universal Asynchronous Receiver Or Transmitter 3
0x40061000 UART4 size 0x30 — Universal Asynchronous Receiver Or Transmitter 4
0x40062000 SPI3 size 0x70 — Serial Peripheral Interface 3
0x40063000 I2C2 size 0x174 — Inter-Integrated Circuit 2
0x40064000 PMBUS size 0xEC — Power Management Bus
0x40065000 BTIM1 size 0x1C — Basic Timer 1
0x40065020 BTIM2 size 0x1C — Basic Timer 2
0x4006A000 EPG size 0x60 — Embedded Pattern Generator
0x4006B000 DCC2 size 0x24 — Dual-Clock Comparator 2
0x4006C000 DCC3 size 0x24 — Dual-Clock Comparator 3
0x4006D000 SPI4 size 0x70 — Serial Peripheral Interface 4
0x4006E000 DBG size 0x20 — Debug Support
0x40070000 CLB1 size 0x1FC — Configurable Logic Block 1
0x40071000 CLB2 size 0x1FC — Configurable Logic Block 2
0x40072000 CLB3 size 0x1FC — Configurable Logic Block 3
0x40073000 CLB4 size 0x1FC — Configurable Logic Block 4
0x40074000 CLB5 size 0x1FC — Configurable Logic Block 5
0x40075000 CLB6 size 0x1FC — Configurable Logic Block 6
0x40080000 LIN1 size 0x104 — Local Interconnect Network 1
0x40081000 LIN2 size 0x104 — Local Interconnect Network 2
0x40082000 TRNG size 0xB0 — True Random Number Generator
0x40084000 CANFD1 size 0x3200 — Controller Area Network FD 1
0x40088000 CAN1 size 0x3080 — Controller Area Network 1
0x4008C000 AESHASH size 0x84 — Advanced Encryption Standard
0x40090000 SEMA size 0x44 — Semaphores
0x40092000 CRC2 size 0xC — Cyclic Redundancy Check 2
0x40093000 DMAMUX2 size 0x80 — Direct Memory Access Multiplexer 2
0x40094000 EDMA2 size 0x1400 — Enhanced Direct Memory Access 2
0x40098000 BGCRC2 size 0x14 — Cyclic Redundancy Check Compute Element 2
0x40099000 FMU size 0x220 — Fault Management Unit
0x4009A000 UPP size 0x90 — Universal Parallel Port
0x4009C000 CANFD2 size 0x3200 — Controller Area Network FD 2
0x400A0000 GPIOA size 0x70 — General-Purpose Input Or Output A
0x400A0400 GPIOB size 0x70 — General-Purpose Input Or Output B
0x400A0800 GPIOC size 0x70 — General-Purpose Input Or Output C
0x400A0C00 GPIOD size 0x70 — General-Purpose Input Or Output D
0x400A1000 GPIOE size 0x70 — General-Purpose Input Or Output E
0x400A1400 GPIOF size 0x70 — General-Purpose Input Or Output F
0x400A1800 GPIOG size 0x70 — General-Purpose Input Or Output G
0x400A1C00 GPIOH size 0x70 — General-Purpose Input Or Output H
0x400A3000 ADCARESULT size 0xF0 — Analog-to-Digital Converter A Result
0x400A3400 ADCBRESULT size 0xF0 — Analog-to-Digital Converter B Result
0x400A3800 ADCCRESULT size 0xF0 — Analog-to-Digital Converter C Result
0x400A3C00 ADCDRESULT size 0xF0 — Analog-to-Digital Converter D Result
0x400B0000 RCC size 0x2F0 — Reset And Clock Control
0x400B1000 FLASH size 0x304 — Embedded Flash Memory
0x400B2000 SRAM size 0x5C — On-Chip SRAM
0x400B3000 SMPU size 0x294 — System Memory Protection Unit
0x400B4000 DMAMUX1 size 0x80 — Direct Memory Access Multiplexer 1
0x400B5000 BGCRC1 size 0x14 — Cyclic Redundancy Check Compute Element 1
0x400B6000 EMATH size 0x2A0 — EMATH register list
0x400B8000 EDMA1 size 0x1400 — Enhanced Direct Memory Access 1
0x400BC000 EMIF size 0xF8 — External Memory Controller
0x400BD000 CRC1 size 0xC — Cyclic Redundancy Check 1
0x400BE000 MMATH size 0x2A0 — Math Operation Accelerator
0x400C0000 MU size 0x28 — Messaging Unit
0x400C2000 WWDG size 0xC — System window watchdog
0x400C3000 IWDG1 size 0x18 — Independent Watchdog 1
0x400C4000 EXTI size 0x54 — Extended Interrupt And Event Controller
0x400C5000 STIM1 size 0x120 — System Timer 1
0x400C6000 STIM2 size 0x120 — System Timer 2
0x400C7000 STIM3 size 0x120 — System Timer 3
0x84000000 QSPI size 0x808 — Quad Serial Peripheral Interface
0xE0080000 MCM size 0x1C — Miscellaneous Control Module

## Interrupts
0 WWDG — WWDG Interrupt
1 IWDG1 — IWDG1 interrupt
2 IWDG2 — IWDG2 interrupt
3 LVD (PWR) — LVD Voltage alarm interrupt
4 FLASH — FLASH interrupt
5 FLASH_ECCERR (FLASH) — FLASH ecc error interrupt
6 RAM_ECCERR (SRAM) — SRAM ecc error interrupt
7 RCC — RCC interrupt
8 EXTI3_0 (EXTI) — EXTI 3~0 in CPUx interrupt
9 EXTI7_4 (EXTI) — EXTI 7~4 in CPUx interrupt
10 EXTI11_8 (EXTI) — EXTI 11~8 in CPUx interrupt
11 EXTI15_12 (EXTI) — EXTI 15~12 in CPUx interrupt
12 EXTI_CMP (EXTI) — EXTI CMP in CPUx interrupt
13 EXTI_XINT2_1 (EXTI) — EXTI XINT2~1 in CPUx interrupt
14 EXTI_XINT5_3 (EXTI) — EXTI XINT5~3 in CPUx interrupt
{n+15} EDMA1_CH{n} (EDMA1) (n=0..31)
47 EDMA1_ERR (EDMA1)
{n+48} EDMA2_CH{n} (EDMA2) (n=0..31)
80 EDMA2_ERR (EDMA2)
81 ADCA_CONV (ADCA) — ADCA convert and start 1 interrupt
82 ADCA_EVENT (ADCA) — ADCA error event interrupt
83 ADCB_CONV (ADCB) — ADCB convert and start 1 interrupt
84 ADCB_EVENT (ADCB) — ADCB error event interrupt
85 ADCC_CONV (ADCC) — ADCC convert and start 1 interrupt
86 ADCC_EVENT (ADCC) — ADCC error event interrupt
87 ADCD_CONV (ADCD) — ADCC convert and start 1 interrupt
88 ADCD_EVENT (ADCD) — ADCC error event interrupt
89 ADC_SAFE_CHK (ADCSAFETYCHKAGG1) — CPUx ADC result exceeds threshold interrupt.
{n+89} EPWM{n}_TZINT (EPWM{n}) (n=1..18) — EPWM{n} trip zone(fault protect) interrupt
{n+107} EPWM{n}_INT (EPWM{n}) (n=1..18) — EPWM{n} event interrupt
126 ECAP1 — ECAP1 interrupt
127 ECAP2 — ECAP2 interrupt
128 ECAP3 — ECAP3 interrupt
129 ECAP4 — ECAP4 interrupt
130 ECAP5 — ECAP5 interrupt
131 ECAP6 — ECAP6 interrupt
132 ECAP7 — ECAP7 interrupt
133 EQEP1 — EQEP1 interrupt
134 EQEP2 — EQEP2 interrupt
135 EQEP3 — EQEP3 interrupt
136 EQEP4 — EQEP4 interrupt
137 EQEP5 — EQEP5 interrupt
138 EQEP6 — EQEP6 interrupt
139 EPG — EPG shfit(all and half) interrupt
140 SDFM1_DR_1 (SDFM1) — SDFM1 channel 1 update interrupt
141 SDFM1_DR_2 (SDFM1) — SDFM1 channel 2 update interrupt
142 SDFM1_DR_3 (SDFM1) — SDFM1 channel 3 update interrupt
143 SDFM1_DR_4 (SDFM1) — SDFM1 channel 4 update interrupt
144 SDFM1_ERR (SDFM1) — SDFM1 error interrupt
145 SDFM2_DR_1 (SDFM2) — SDFM2 channel 1 update interrupt
146 SDFM2_DR_2 (SDFM2) — SDFM2 channel 2 update interrupt
147 SDFM2_DR_3 (SDFM2) — SDFM2 channel 3 update interrupt
148 SDFM2_DR_4 (SDFM2) — SDFM2 channel 4 update interrupt
149 SDFM2_ERR (SDFM2) — SDFM2 error interrupt
150 SDFM3_DR_1 (SDFM3) — SDFM3 channel 1 update interrupt
151 SDFM3_DR_2 (SDFM3) — SDFM3 channel 2 update interrupt
152 SDFM3_DR_3 (SDFM3) — SDFM3 channel 3 update interrupt
153 SDFM3_DR_4 (SDFM3) — SDFM3 channel 4 update interrupt
154 SDFM3_ERR (SDFM3) — SDFM3 error interrupt
155 SDFM4_DR_1 (SDFM4) — SDFM4 channel 1 update interrupt
156 SDFM4_DR_2 (SDFM4) — SDFM4 channel 2 update interrupt
157 SDFM4_DR_3 (SDFM4) — SDFM4 channel 3 update interrupt
158 SDFM4_DR_4 (SDFM4) — SDFM4 channel 4 update interrupt
159 SDFM4_ERR (SDFM4) — SDFM4 error interrupt
160 LPTIM — LPTIM counting overflow interrupt
161 CAN1_1 (CAN1) — CAN1 commutation and state interrupt 1
162 CAN1_2 (CAN1) — CAN1 commutation and state interrupt 2
163 CAN1_ECC (CAN1) — CAN1 ECC interrupt
164 CAN1_WKUP (CAN1) — CAN1 wakeup interrupt
165 CANFD1_1 (CANFD1) — CANFD1 commutation and state interrupt 1
166 CANFD1_2 (CANFD1) — CANFD1 commutation and state interrupt 2
167 CANFD1_ECC (CANFD1) — CANFD1 ECC interrupt
168 CANFD1_WKUP_TS (CANFD1) — CANFD1 wakeup and ts interrupt
169 CANFD2_1 (CANFD2) — CANFD2 commutation and state interrupt 1
170 CANFD2_2 (CANFD2) — CANFD2 commutation and state interrupt 2
171 CANFD2_ECC (CANFD2) — CANFD2 ECC interrupt
172 CANFD2_WKUP_TS (CANFD2) — CANFD2 wakeup and ts interrupt
173 BTIM1 — BTIM1 interrrupt
174 BTIM2 — BTIM2 interrrupt
175 STIM1 — STIM1 overflow and capture interrupt
176 STIM2 — STIM2 overflow and capture interrupt
177 STIM3 — STIM3 overflow and capture interrupt
178 TIM1 — TIM1 interrupt
179 TIM2 — TIM2 interrupt
180 AWK — AWK overflow interrupt
181 LIN1 — LIN1 interrupt
182 LIN2 — LIN2 interrupt
183 I2C1_MST (I2C1) — I2C1 Master interrupt
184 I2C1_SLV (I2C1) — I2C1 Slaver interrupt
185 I2C2_MST (I2C2) — I2C2 Master interrupt
186 I2C2_SLV (I2C2) — I2C2 Slaver interrupt
188 PMBUS — PMBUS interrupt
189 SPI1_RX (SPI1) — SPI1 receive interrupt
190 SPI1_TX (SPI1) — SPI1 transmit interrupt
191 SPI2_RX (SPI2) — SPI2 receive interrupt
192 SPI2_TX (SPI2) — SPI2 transmit interrupt
193 SPI3_RX (SPI3) — SPI3 receive interrupt
194 SPI3_TX (SPI3) — SPI3 transmit interrupt
195 SPI4_RX (SPI4) — SPI4 receive interrupt
196 SPI4_TX (SPI4) — SPI4 transmit interrupt
197 UART1_TX (UART1) — UART1 transmission interrupt
198 UART1_RX (UART1) — UART1 receiving Interrupt
199 UART2_TX (UART2) — UART2 transmission interrupt
200 UART2_RX (UART2) — UART2 receiving Interrupt
201 UART3_TX (UART3) — UART3 transmission interrupt
202 UART3_RX (UART3) — UART3 receiving Interrupt
203 UART4_TX (UART4) — UART4 transmission interrupt
204 UART4_RX (UART4) — UART4 receiving Interrupt
205 AESHASH — AESHASH interrupt
206 TRNG — TRNG interrupt
207 QSPI — QSPI interrupt
208 EMATH — EMATH interrupt
209 DCC1 — DCC1 module monitors clock error interrupts
210 DCC2 — DCC2 module monitors clock error interrupts
211 DCC3 — DCC3 module monitors clock error interrupts
212 MCM — CPU MCM event interrupt
213 VDDRDY (PWR) — VDD Low-voltage alarm interrupt
214 FMU_CFG (FMU) — FMU config error Interrupt
215 FMU_EVT (FMU) — FMU event error Interrupt
216 CLB1 — CLB1 HLC interrupt
217 CLB2 — CLB2 HLC interrupt
218 CLB3 — CLB3 HLC interrupt
219 CLB4 — CLB4 HLC interrupt
220 CLB5 — CLB5 HLC interrupt
221 CLB6 — CLB6 HLC interrupt
222 EMIF
223 UPP — UPP interrupt
224 MU — MailBox CPUx interrupt
225 MMATH — MMATH trip interrupt
226 EXTI_TXEV (EXTI) — CPUx event send interrupt
